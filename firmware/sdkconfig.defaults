## firmware/sdkconfig.defaults
```kconfig
# 焊点缺陷检测仪 —— YD-ESP32-S3-N16R8(16MB Flash / 8MB Octal PSRAM)
CONFIG_IDF_TARGET="esp32s3"

# Flash
CONFIG_ESPTOOLPY_FLASHSIZE_16MB=y
CONFIG_ESPTOOLPY_FLASHMODE_QIO=y
CONFIG_ESPTOOLPY_FLASHFREQ_80M=y

# CPU
CONFIG_ESP_DEFAULT_CPU_FREQ_MHZ_240=y

# Octal PSRAM(GPIO35/36/37 为模组内部占用,载板不外接)
CONFIG_SPIRAM=y
CONFIG_SPIRAM_MODE_OCT=y
CONFIG_SPIRAM_SPEED_80M=y
CONFIG_SPIRAM_USE_MALLOC=y
CONFIG_SPIRAM_MALLOC_ALWAYSINTERNAL=65536
CONFIG_SPIRAM_TRY_ALLOCATE_WIFI_LWIP=y

# FreeRTOS / 主任务
CONFIG_FREERTOS_HZ=1000
CONFIG_ESP_MAIN_TASK_STACK_SIZE=8192

# 性能
CONFIG_COMPILER_OPTIMIZATION_PERF=y
CONFIG_LOG_DEFAULT_LEVEL_INFO=y

# LVGL 9:ILI9341 高字节在前,渲染进缓冲时软件交换字节序
CONFIG_LV_COLOR_16_SW_SWAP=y
# 内置中文字体(常用 1000 汉字),界面文案需限制在常用字集
CONFIG_LV_FONT_SIMSUN_16_CJK=y
CONFIG_LV_MEM_CUSTOM=y
CONFIG_LV_MEM_CUSTOM_INCLUDE="esp_heap_caps.h"
```
